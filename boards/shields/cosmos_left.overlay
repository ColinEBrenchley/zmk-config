/*
 * Copyright (c) 2022 The ZMK Contributors
 *
 * SPDX-License-Identifier: MIT
 */

#include "cosmos.dtsi"

/ {
    chosen {
        zephyr,console = &cdc_acm_uart0;
        zmk,split_role = "central";
    };
};

&usbd {
    cdc_acm_uart0: cdc_acm_uart0 {
        compatible = "zephyr,cdc-acm-uart";
    };
};
