#include <dt-bindings/zmk/matrix_transform.h>
#include "six_by_six.dtsi"
#include <dt-bindings/led/led.h>

/ {
    chosen {
        zmk,kscan = &kbd_matrix;
        zmk,physical-layout = &default_layout;
    };

    kbd_matrix: kscan {
    compatible = "zmk,kscan-gpio-matrix";
    diode-direction = "row2col";

    row-gpios
        = <&gpio0 20 GPIO_ACTIVE_HIGH>
        , <&gpio0 8  GPIO_ACTIVE_HIGH>
        , <&gpio0 22 GPIO_ACTIVE_HIGH>
        , <&gpio0 6  GPIO_ACTIVE_HIGH>
        , <&gpio0 24 GPIO_ACTIVE_HIGH>
        , <&gpio0 17 GPIO_ACTIVE_HIGH>
        , <&gpio0 2 GPIO_ACTIVE_HIGH>
        ;

    col-gpios
        = <&gpio1 6  (GPIO_ACTIVE_HIGH | GPIO_PULL_DOWN)>
        , <&gpio1 0  (GPIO_ACTIVE_HIGH | GPIO_PULL_DOWN)>
        , <&gpio1 15 (GPIO_ACTIVE_HIGH | GPIO_PULL_DOWN)>
        , <&gpio1 4  (GPIO_ACTIVE_HIGH | GPIO_PULL_DOWN)>
        , <&gpio0 11 (GPIO_ACTIVE_HIGH | GPIO_PULL_DOWN)>
        ;
    };
};
