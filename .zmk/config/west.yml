## Kconfig
```kconfig
menuconfig LED_FX
	bool "LED FX support"
	depends on LED_STRIP

if LED_FX

config LED_FX_MAX_BRIGHTNESS
	int "Maximum LED FX brightness (percent)"
	range 5 100
	default 50

config LED_FX_DEFAULT_BRIGHTNESS
	int "Default LED FX brightness (percent)"
	range 5 LED_FX_MAX_BRIGHTNESS
	default 30

config LED_FX_FLASH_MAX_BRIGHTNESS
	int "Maximum white-equivalent flash brightness (percent)"
	range 5 100
	default 60
	help
	  Peak brightness for the one-shot flash effects, expressed as the
	  brightness a full-white flash may use. Colors that drive fewer than
	  three channels are scaled up so their total current stays within the
	  same budget. Raise this only if the board stays stable; full-white
	  flashes above the USB current limit can brown out the 5V rail.

config LED_FX_SWEEP_ON_KEYPRESS
	bool "Trigger an LED sweep on every key press"
	default n

endif
```

## boards/shields/Kconfig.defconfig
```kconfig
# Cosmos shield configuration

if SHIELD_COSMOS_LEFT

config ZMK_KEYBOARD_NAME
    default "Cosmos Left"

endif

if SHIELD_COSMOS_RIGHT

config ZMK_KEYBOARD_NAME
    default "Cosmos Right"

endif
```

## boards/shields/Kconfig.shield
```kconfig
# Copyright (c) 2022 The ZMK Contributors
# SPDX-License-Identifier: MIT

config SHIELD_COSMOS_LEFT
    def_bool $(shields_list_contains,cosmos_left)

config SHIELD_COSMOS_RIGHT
    def_bool $(shields_list_contains,cosmos_right)

config SHIELD_LILY58_LEFT
    def_bool $(shields_list_contains,lily58_left)

config SHIELD_LILY58_RIGHT
    def_bool $(shields_list_contains,lily58_right)
```

## boards/shields/cosmos/Kconfig.defconfig
```kconfig
if SHIELD_COSMOS_LEFT

config ZMK_KEYBOARD_NAME
    default "Cosmos"

config ZMK_SPLIT_ROLE_CENTRAL
    default y

endif # SHIELD_COSMOS_LEFT

if SHIELD_COSMOS_LEFT || SHIELD_COSMOS_RIGHT

config ZMK_SPLIT
    default y

endif # SHIELD_COSMOS_LEFT || SHIELD_COSMOS_RIGHT
```

## boards/shields/six_by_six/Kconfig.defconfig
```kconfig
if SHIELD_SIX_BY_SIX

config ZMK_KEYBOARD_NAME
    default "6x6 Keyboard"

endif # SHIELD_SIX_BY_SIX
```

## config/west.yml
```yaml
manifest:
  remotes:
    - name: zmkfirmware
      url-base: https://github.com/zmkfirmware
    # Additional modules containing boards/shields/custom code can be listed here as well
    # See https://docs.zephyrproject.org/3.2.0/develop/west/manifest.html#projects
    - name: zzeneg # <-- required for Raw HID module
      url-base: https://github.com/zzeneg
    - name: srwi # <-- required for KeyPeek module
      url-base: https://github.com/srwi
  projects:
    - name: zmk
      remote: zmkfirmware
      revision: main
      revision: v0.3-branch
      import: app/west.yml
    - name: zmk-raw-hid # <-- Raw HID module
      remote: zzeneg
      revision: main
    - name: zmk-keypeek-layer-notifier # <-- KeyPeek module
      remote: srwi
      revision: master
  self:
    path: config
    path: config
```

## dts/bindings/behaviors/zmk,behavior-led-fx.yaml
```yaml
description: "LED effects behavior (one parameter: effect / command id)"

compatible: "zmk,behavior-led-fx"

include: one_param.yaml
```
